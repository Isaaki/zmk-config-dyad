## boards/shields/dyad/Kconfig.defconfig
```kconfig
# if SHIELD_DYAD
#
# config ZMK_KEYBOARD_NAME
#   default "dyad"
#
# endif


if SHIELD_DYAD_LEFT

# Name must be less than 16 characters long!
config ZMK_KEYBOARD_NAME
    default "Dyad"

config ZMK_SPLIT_ROLE_CENTRAL
    default y

endif

if SHIELD_DYAD_LEFT || SHIELD_DYAD_RIGHT

config ZMK_SPLIT
    default y

endif

# Dongle config

if SHIELD_DYAD_DONGLE

# Max 16 characters in keyboard name
config ZMK_KEYBOARD_NAME
    default "Dyad"

config ZMK_SPLIT_ROLE_CENTRAL
    default y

config ZMK_SPLIT
    default y

config ZMK_STUDIO
    default y
config ZMK_STUDIO_RPC_USB
    default y
config USB_DEVICE_STACK
    default y
config USB_CDC_ACM
    default y
config UART_CONSOLE
    default n

# Set this to the number of peripherals your dongle will have.
# For a unibody, this would be 1. If you have left and right halves, set it to 2, etc.
config ZMK_SPLIT_BLE_CENTRAL_PERIPHERALS
    default 2

# Set this to ZMK_SPLIT_BLE_CENTRAL_PERIPHERALS + your desired number of BT profiles (default is 5)
config BT_MAX_CONN
    default 6

# Set this to the same number as BT_MAX_CONN
config BT_MAX_PAIRED
    default 6

endif
```

## config/Kconfig.shield
```kconfig
# config SHIELD_DYAD
#   def_bool $(shields_list_contains, dyad)

# No whitespace after the comma or in your part name!
config SHIELD_DYAD_LEFT
    def_bool $(shields_list_contains,dyad_left)

# No whitespace after the comma or in your part name!
config SHIELD_DYAD_RIGHT
    def_bool $(shields_list_contains,dyad_right)
```

## config/boards/shields/dyad/Kconfig.shield
```kconfig
# config SHIELD_DYAD
#   def_bool $(shields_list_contains, dyad)

# No whitespace after the comma or in your part name!
config SHIELD_DYAD_LEFT
    def_bool $(shields_list_contains,dyad_left)

# No whitespace after the comma or in your part name!
config SHIELD_DYAD_RIGHT
    def_bool $(shields_list_contains,dyad_right)

# No whitespace after the comma or in the keyboard name!
config SHIELD_DYAD_DONGLE
    def_bool $(shields_list_contains,dyad_dongle)
```
